## layers/meta-rust-app/conf/layer.conf
```bitbake
# We have a conf and classes directory, add to BBPATH
BBPATH .= ":${LAYERDIR}"

# We have recipes-* directories, add to BBFILES
BBFILES += "${LAYERDIR}/recipes-*/*/*.bb \
            ${LAYERDIR}/recipes-*/*/*.bbappend"

BBFILE_COLLECTIONS += "meta-rust-app"
BBFILE_PATTERN_meta-rust-app = "^${LAYERDIR}/"
BBFILE_PRIORITY_meta-rust-app = "6"

LAYERDEPENDS_meta-rust-app = "core"
LAYERSERIES_COMPAT_meta-rust-app = "scarthgap"
```
